## conf/layer.conf
```bitbake
# We have a conf and classes directory, add to BBPATH
BBPATH .= ":${LAYERDIR}"

# We have recipes-* directories, add to BBFILES
BBFILES += "${LAYERDIR}/recipes-*/*/*.bb \
            ${LAYERDIR}/recipes-*/*/*.bbappend"

BBFILE_COLLECTIONS += "yocto-meta-phytium"
BBFILE_PATTERN_yocto-meta-phytium = "^${LAYERDIR}/"
BBFILE_PRIORITY_yocto-meta-phytium = "6"

LAYERDEPENDS_yocto-meta-phytium = "core"
LAYERSERIES_COMPAT_yocto-meta-phytium = "kirkstone"
```

## conf/machine/include/fte2000q.inc
```bitbake
MACHINE_FEATURES += "efi pci"

DEFAULTTUNE = "aarch64"

# set IMAGETYPE
KERNEL_IMAGETYPE = "uImage Image.gz Image"

# serial port
SERIAL_CONSOLES = "115200;ttyAMA1"

IMAGE_INSTALL:append = " kernel-modules"

include conf/machine/include/arm/arch-armv8a.inc
```

## conf/machine/xspeed-ntxx.conf
```bitbake
#


MACHINEOVERRIDES =. "xspeed-ntxx:"

MCS_FEATURES = ""

require conf/machine/include/fte2000q.inc
```
